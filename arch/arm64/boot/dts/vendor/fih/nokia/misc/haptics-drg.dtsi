/*
 * CTL/DRG haptics: an ERM motor on the PM660 haptics block.
 *
 * The 4.4 FIH kernel replaced the node with a "qcom,qpnp-haptic"
 * (timed_output) one. That driver needs the staging timed_output class,
 * which 4.19 doesn't have; 4.19 drives this block with qti-haptics
 * (compatible "qcom,pm660-haptics", input force feedback). Keep that
 * node and only switch it from the MTP's LRA to FIH's ERM settings.
 */
&pm660_haptics {
	qcom,actuator-type = "erm";
	qcom,vmax-mv = <3000>;
	qcom,play-rate-us = <6667>;
	/delete-property/ qcom,lra-resonance-sig-shape;
	/delete-property/ qcom,lra-auto-resonance-mode;
	/delete-property/ qcom,lra-allow-variable-play-rate;
};
